# STM32F411xx register map
File version: 1.0
Registers are 32-bit, read-write, reset 0x0 unless marked. A register's access mark holds for its fields unless they carry their own. Offsets are from the block's base; lines under a group give offsets from that group; [hi:lo] are bit positions; {n}, {i} and the like mark numbered series; 'fields as' and 'values as' point back to an identical list; <NAME> marks a mode.

## Memory map
0x40000000 TIM2 size 0x400 — General purpose timers
0x40000400 TIM3 size 0x400 — General purpose timers
0x40000800 TIM4 size 0x400
0x40000C00 TIM5 size 0x400 — General-purpose-timers
0x40002800 RTC size 0x400 — Real-time clock
0x40002C00 WWDG size 0x400 — Window watchdog
0x40003000 IWDG size 0x400 — Independent watchdog
0x40003400 I2S2ext size 0x400 — Serial peripheral interface
0x40003800 SPI2 size 0x400
0x40003C00 SPI3 size 0x400
0x40004000 I2S3ext size 0x400
0x40004400 USART2 size 0x400
0x40005400 I2C1 size 0x400
0x40005800 I2C2 size 0x400
0x40005C00 I2C3 size 0x400 — Inter-integrated circuit
0x40007000 PWR size 0x400 — Power control
0x40010000 TIM1 size 0x400 — Advanced-timers
0x40010400 TIM8 size 0x400
0x40011000 USART1 size 0x400 — Universal synchronous asynchronous receiver transmitter
0x40011400 USART6 size 0x400
0x40012000 ADC1 size 0x400 — Analog-to-digital converter
0x40012300 ADC_Common size 0x100 — ADC common registers
0x40012C00 SDIO size 0x400 — Secure digital input/output interface
0x40013000 SPI1 size 0x400
0x40013400 SPI4 size 0x400
0x40013800 SYSCFG size 0x400 — System configuration controller
0x40013C00 EXTI size 0x400 — External interrupt/event controller
0x40014000 TIM9 size 0x400 — General purpose timers
0x40014400 TIM10 size 0x400 — General-purpose-timers
0x40014800 TIM11 size 0x400 — General-purpose-timers
0x40015000 SPI5 size 0x400
0x40020000 GPIOA size 0x400 — General-purpose I/Os
0x40020400 GPIOB size 0x400 — General-purpose I/Os
0x40020800 GPIOC size 0x400
0x40020C00 GPIOD size 0x400
0x40021000 GPIOE size 0x400
0x40021C00 GPIOH size 0x400 — General-purpose I/Os
0x40023000 CRC size 0x400 — Cryptographic processor
0x40023800 RCC size 0x400 — Reset and clock control
0x40023C00 FLASH size 0x400
0x40026000 DMA1 size 0x400
0x40026400 DMA2 size 0x400 — DMA controller
0x50000000 OTG_FS_GLOBAL size 0x400 — USB on the go full speed
0x50000400 OTG_FS_HOST size 0x400 — USB on the go full speed
0x50000800 OTG_FS_DEVICE size 0x400 — USB on the go full speed
0x50000E00 OTG_FS_PWRCLK size 0x400 — USB on the go full speed
0xE000E000 NVIC size 0x1001 — Nested Vectored Interrupt Controller
0xE000E010 SysTick size 0x10 — SysTick Timer. Identical register set on every Cortex-M core (ARMv6-M through current ARMv8-M).
0xE000ED00 SCB size 0x90 — System Control Block, ARMv7-M register set. Verified against CMSIS_5 core_cm3.h/core_cm4.h defines (both are identical at the SCB level -- the FPU-related extras live in a separate optional FPU block, not shown here, since plain Cortex-M3 has no FPU at all). PFR/DFR/ADR/MMFR/ISAR are read-only ID registers whose exact values are implementation specific.
0xE000ED90 MPU size 0x30 — Memory Protection Unit -- OPTIONAL on ARMv7-M (__MPU_PRESENT). When present, includes 3 alias RBAR/RASR pairs so up to 4 regions can be programmed without re-writing RNR each time (verified against CMSIS core_cm3.h/core_cm4.h: MPU_TYPE_RALIASES=4).
0xE000EDF0 CoreDebug size 0x10 — Core Debug Registers (DHCSR, DCRSR, DCRDR, DEMCR). Fixed ADIv5/CoreSight debug architecture -- identical on every Cortex-M core.
0xE0042000 DBG size 0x400 — Debug support

## Interrupts
1 PVD (WWDG) — PVD through EXTI line detection interrupt
2 TAMP_STAMP (EXTI) — Tamper and TimeStamp interrupts through the EXTI line
3 RTC_WKUP (DMA1) — RTC Wakeup interrupt through the EXTI line
4 FLASH — FLASH global interrupt
5 RCC (DMA2) — RCC global interrupt
6 EXTI0 (EXTI) — EXTI Line0 interrupt
7 EXTI1 (EXTI) — EXTI Line1 interrupt
8 EXTI2 (EXTI) — EXTI Line2 interrupt
9 EXTI3 (EXTI) — EXTI Line3 interrupt
10 EXTI4 (EXTI) — EXTI Line4 interrupt
18 ADC (ADC1) — ADC1 global interrupt
23 EXTI9_5 (EXTI) — EXTI Line[9:5] interrupts
24 TIM1_BRK_TIM9 (GPIOD) — TIM1 Break interrupt and TIM9 global interrupt
25 TIM1_UP_TIM10 (GPIOD, GPIOC) — TIM1 Update interrupt and TIM10 global interrupt
26 TIM1_TRG_COM_TIM11 (GPIOD, GPIOB) — TIM1 Trigger and Commutation interrupts and TIM11 global interrupt
27 TIM1_CC (GPIOD) — TIM1 Capture Compare interrupt
28 TIM2 (GPIOA) — TIM2 global interrupt
29 TIM3 (I2C3) — TIM3 global interrupt
31 I2C1_EV (RCC, I2S2ext) — I2C1 event interrupt
32 I2C1_ER (RCC, I2S2ext) — I2C1 error interrupt
33 I2C2_EV (RTC, I2C1) — I2C2 event interrupt
34 I2C2_ER (RTC, I2C1) — I2C2 error interrupt
35 SPI1 (TIM10, SPI2) — SPI1 global interrupt
36 SPI2 (TIM11, SPI3) — SPI2 global interrupt
40 EXTI15_10 (EXTI) — EXTI Line[15:10] interrupts
41 RTC_Alarm (DMA1) — RTC Alarms (A and B) through EXTI line interrupt
42 OTG_FS_WKUP (USART1) — USB On-The-Go FS Wakeup through EXTI line interrupt
49 SDIO (GPIOH) — SDIO global interrupt
51 SPI3 (TIM2, SPI4) — SPI3 global interrupt
67 OTG_FS (USART1) — USB On The Go FS global interrupt
72 I2C3_EV (SDIO, I2C2) — I2C3 event interrupt
73 I2C3_ER (SDIO, I2C2) — I2C3 error interrupt
81 FPU (ADC_Common) — FPU interrupt
84 SPI4 (TIM3) — SPI4 global interrupt
